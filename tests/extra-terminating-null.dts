/dts-v1/;

/ {
	extranull0 = "hello world";
	extranull1,1 = "hello world\0";
	extranull1,2 = "hello world", "";
	extranull2,1 = "hello world\0\0";
	extranull2,2 = "hello world", "", "";
	extranull2,3 = "hello world\0", "";
	extranull2,4 = "hello world", "\0";
};
