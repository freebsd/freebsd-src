/dts-v1/;

/ {
	model = "SomeModel";
	compatible = "Nothing";
	#address-cells = <2>;
	#size-cells = <2>;

        memory@0 {
                device_type = "memory";
		reg = <0x00000000 0x00000000 0x00000000 0x20000000>;
        };

	cpus {
		#address-cells = <1>;
		#size-cells = <0>;
		d10 = < 10>;		// hex: 0xa
		d23 = < 23>;		// hex: 0x17
		b101 = < 0x5>;	// hex: 0x5
		o17 = < 017>;		// hex: 0xf
		hd00d = < 0xd00d>;	// hex: 0xd00d

		//   hex:  0x4d2    0x163e      0x2334    0xd80
		stuff = < 1234     5678     9012     3456>;


		bad-d-1 = < 0>;		// Hrm. 0
		bad-d-2 = < 123456789012345>;
		bad-o-1 = < 00>;
		bad-o-2 = < 0123456123456>;
	};

};
