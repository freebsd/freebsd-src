/*
 * Copyright (c) 2016 NextThing Co
 * Copyright (c) 2016 Free Electrons
 *
 * SPDX-License-Identifier:	GPL-2.0+
 */

/include/ "overlay_bad_fixup_base.dtsi"

/ {
	__fixups__ {
		test = "/fragment@0";
	};
};
