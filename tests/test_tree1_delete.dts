/dts-v1/;

/include/ "test_tree1.dts"

/ {
	nonexistant-property = <0xdeadbeef>;

	nonexistant-subnode {
		prop-int = <1>;
	};

	dellabel: deleted-by-label {
		prop-int = <1>;
	};

	subnode@1 {
		delete-this-str = "deadbeef";
	};

};

/ {
	/delete-property/ nonexistant-property;

	/delete-node/ nonexistant-subnode;

	subnode@1 {
		/delete-property/ delete-this-str;
	};
};

/delete-node/ &dellabel;

/ {
	/delete-property/ prop-str;
};

/ {
	prop-str = "hello world";
};

/ {
	subnode@1 {
		/delete-node/ ss1;
	};
};

/ {
	subnode@1 {
		ss1 {
		};
	};
};

/{
	duplabel1: foo1 = "bar";
	duplabel2: foo2 = "bar";
};

/{
	duplabel1: baz1 = "qux";
	duplabel2: baz2 = "qux";
};

/{
	/delete-property/ foo1;
	/delete-property/ baz2;
};
