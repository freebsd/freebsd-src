/dts-v1/;

/include/ "include2.dts"
/memreserve/ /include/ "include3.dts";

/ {
	/include/ "include4.dts"
	/include/ "include5.dts" = <0xdeadbeef>;
	prop-int64 /include/ "include5a.dts";
	prop-str = /include/ "include6.dts";
	#address-cells = <1>;
	#size-cells = <0>;

	/include/ "include7.dts"

	subnode@2 {
		reg = <2>;
		linux,phandle = <0x2000>;
		prop-int = <123456789>;
		#address-cells = <1>;
		#size-cells = <0>;

		/include/ "include8.dts"
			phandle = <0x2001>;
			compatible = "subsubnode2", "subsubnode";
			prop-int = <0726746425>;
		};

		ss2 {
		};
	};
};
