/dts-v1/;

/ {
	compatible = "example,pci-bridge-ok";
	#address-cells = < 2 >;
	#size-cells = < 2 >;
	p@0 {
		device_type = "pci";
		compatible = "example,pci-bridge";
		#address-cells = < 3 >;
		#size-cells = < 2 >;
		reg = <0 0 0 0x1000>;
		bus-range = <0 0xff>;
		ranges = <0 0 0 0 0 0 0x10000>;
	};
};
