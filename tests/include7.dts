	subnode@1 {
		compatible = "subnode1";
		reg = <1>;
		prop-int = [deadbeef];

		subsubnode {
			compatible = "subsubnode1", "subsubnode";
			placeholder = "this is a placeholder string", "string2";
			prop-int = <0xdeadbeef>;
		};

		ss1 {
		};
	};
