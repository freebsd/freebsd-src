/dts-v1/;
#include "cv181x_base_arm.dtsi"
#include "cv181x_asic_bga.dtsi"
#include "cv181x_asic_sd.dtsi"
#include "cv181x_default_memmap.dtsi"

/ {

	sd:cv-sd@4310000 {
		max-frequency = <10000000>;
	};
};

