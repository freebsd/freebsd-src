/dts-v1/;
/plugin/;

#include <dt-bindings/gpio/gpio.h>

/ {
	compatible = "allwinner,sun50i-h5";
};

&{/} {
	vdd_cpux: gpio-regulator {
		compatible = "regulator-gpio";
		pinctrl-names = "default";
		regulator-name = "vdd-cpux";
		regulator-type = "voltage";
		regulator-boot-on;
		regulator-always-on;
		regulator-min-microvolt = <1100000>;
		regulator-max-microvolt = <1300000>;
		regulator-ramp-delay = <50>; /* 4ms */
		gpios = <&r_pio 0 6 GPIO_ACTIVE_HIGH>; /* PL6 */
		gpios-states = <0x1>;
		states = <1100000 0x0
			 1300000 0x1>;
	};

};

&{/cpus/cpu@0} {
	cpu-supply = <&vdd_cpux>;
};

