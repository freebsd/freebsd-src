## net/Config.in
```kconfig
#
# Network configuration
#
mainmenu_option next_comment
comment 'Networking options'
tristate 'Packet socket' CONFIG_PACKET
if [ "$CONFIG_PACKET" != "n" ]; then
   bool '  Packet socket: mmapped IO' CONFIG_PACKET_MMAP
fi

tristate 'Netlink device emulation' CONFIG_NETLINK_DEV

bool 'Network packet filtering (replaces ipchains)' CONFIG_NETFILTER
if [ "$CONFIG_NETFILTER" = "y" ]; then
   bool '  Network packet filtering debugging' CONFIG_NETFILTER_DEBUG
fi
bool 'Socket Filtering'  CONFIG_FILTER
tristate 'Unix domain sockets' CONFIG_UNIX
bool 'TCP/IP networking' CONFIG_INET
if [ "$CONFIG_INET" = "y" ]; then
   source net/ipv4/Config.in
   if [ "$CONFIG_EXPERIMENTAL" = "y" ]; then
#   IPv6 as module will cause a CRASH if you try to unload it
      tristate '  The IPv6 protocol (EXPERIMENTAL)' CONFIG_IPV6
      if [ "$CONFIG_IPV6" != "n" ]; then
	 source net/ipv6/Config.in
      fi
   fi
   if [ "$CONFIG_EXPERIMENTAL" = "y" ]; then
      source net/khttpd/Config.in
   fi
   if [ "$CONFIG_EXPERIMENTAL" = "y" ]; then
      source net/sctp/Config.in
   fi
fi
if [ "$CONFIG_EXPERIMENTAL" = "y" ]; then
   tristate 'Asynchronous Transfer Mode (ATM) (EXPERIMENTAL)' CONFIG_ATM
   if [ "$CONFIG_ATM" = "y" -o "$CONFIG_ATM" = "m" ]; then
      if [ "$CONFIG_INET" = "y" ]; then
	 dep_tristate '  Classical IP over ATM' CONFIG_ATM_CLIP $CONFIG_ATM
	 if [ "$CONFIG_ATM_CLIP" != "n" ]; then
	    bool '    Do NOT send ICMP if no neighbour' CONFIG_ATM_CLIP_NO_ICMP
	 fi
      fi
      dep_tristate '  LAN Emulation (LANE) support' CONFIG_ATM_LANE $CONFIG_ATM
      if [ "$CONFIG_INET" = "y" -a "$CONFIG_ATM_LANE" != "n" ]; then
	 tristate '    Multi-Protocol Over ATM (MPOA) support' CONFIG_ATM_MPOA
      fi
      dep_tristate '  RFC1483/2684 Bridged protocols' CONFIG_ATM_BR2684 $CONFIG_ATM
      if [ "$CONFIG_ATM_BR2684" != "n" ]; then
            bool '    Per-VC IP filter kludge' CONFIG_ATM_BR2684_IPFILTER
      fi
   fi
fi
tristate '802.1Q VLAN Support' CONFIG_VLAN_8021Q

comment ' '
tristate 'The IPX protocol' CONFIG_IPX
if [ "$CONFIG_IPX" != "n" ]; then
   source net/ipx/Config.in
fi

tristate 'Appletalk protocol support' CONFIG_ATALK
source drivers/net/appletalk/Config.in

tristate 'DECnet Support' CONFIG_DECNET
if [ "$CONFIG_DECNET" != "n" ]; then
   source net/decnet/Config.in
fi
dep_tristate '802.1d Ethernet Bridging' CONFIG_BRIDGE $CONFIG_INET
if [ "$CONFIG_EXPERIMENTAL" = "y" ]; then
   tristate 'CCITT X.25 Packet Layer (EXPERIMENTAL)' CONFIG_X25
   tristate 'LAPB Data Link Driver (EXPERIMENTAL)' CONFIG_LAPB
   bool '802.2 LLC (EXPERIMENTAL)' CONFIG_LLC
   bool 'Frame Diverter (EXPERIMENTAL)' CONFIG_NET_DIVERT
#   if [ "$CONFIG_LLC" = "y" ]; then
#      bool '  Netbeui (EXPERIMENTAL)' CONFIG_NETBEUI
#   fi
   if [ "$CONFIG_INET" = "y" ]; then
      tristate 'Acorn Econet/AUN protocols (EXPERIMENTAL)' CONFIG_ECONET
      if [ "$CONFIG_ECONET" != "n" ]; then
	 bool '  AUN over UDP' CONFIG_ECONET_AUNUDP
	 bool '  Native Econet' CONFIG_ECONET_NATIVE
      fi
   fi
   tristate 'WAN router' CONFIG_WAN_ROUTER
   bool 'Fast switching (read help!)' CONFIG_NET_FASTROUTE
   bool 'Forwarding between high speed interfaces' CONFIG_NET_HW_FLOWCONTROL
fi

mainmenu_option next_comment
comment 'QoS and/or fair queueing'
bool 'QoS and/or fair queueing' CONFIG_NET_SCHED
if [ "$CONFIG_NET_SCHED" = "y" ]; then
   source net/sched/Config.in
fi
#bool 'Network code profiler' CONFIG_NET_PROFILE
endmenu

mainmenu_option next_comment
comment 'Network testing'
tristate 'Packet Generator (USE WITH CAUTION)' CONFIG_NET_PKTGEN
endmenu

endmenu
```

## net/ax25/Config.in
```kconfig
#
# Amateur Radio protocols and AX.25 device configuration
#
# 19971130	Now in an own category to make correct compilation of the 
#		AX.25 stuff easier...
#		Joerg Reuter DL1BKE <jreuter@yaina.de>
# 19980129	Moved to net/ax25/Config.in, sourcing device drivers.

mainmenu_option next_comment
comment 'Amateur Radio support'
bool 'Amateur Radio support' CONFIG_HAMRADIO

if [ "$CONFIG_HAMRADIO" != "n" ]; then
   if [ "$CONFIG_NET" != "n" ]; then
      comment 'Packet Radio protocols'
      tristate '  Amateur Radio AX.25 Level 2 protocol' CONFIG_AX25
      if [ "$CONFIG_AX25" != "n" ]; then
	 bool '    AX.25 DAMA Slave support' CONFIG_AX25_DAMA_SLAVE
#	 bool '    AX.25 DAMA Master support' CONFIG_AX25_DAMA_MASTER
	 dep_tristate '    Amateur Radio NET/ROM protocol' CONFIG_NETROM $CONFIG_AX25
	 dep_tristate '    Amateur Radio X.25 PLP (Rose)' CONFIG_ROSE $CONFIG_AX25
      fi

      if [ "$CONFIG_AX25" != "n" ]; then
	 mainmenu_option next_comment
	 comment 'AX.25 network device drivers'

	 source drivers/net/hamradio/Config.in

	 endmenu
      fi
   fi

fi

endmenu
```

## net/bluetooth/Config.in
```kconfig
#
# Bluetooth subsystem configuration
#

if [ "$CONFIG_NET" != "n" ]; then

   mainmenu_option next_comment
   comment 'Bluetooth support'
   dep_tristate 'Bluetooth subsystem support' CONFIG_BLUEZ $CONFIG_NET

   if [ "$CONFIG_BLUEZ" != "n" ]; then
      dep_tristate 'L2CAP protocol support' CONFIG_BLUEZ_L2CAP $CONFIG_BLUEZ
      dep_tristate 'SCO links support' CONFIG_BLUEZ_SCO $CONFIG_BLUEZ
      source net/bluetooth/rfcomm/Config.in
      source net/bluetooth/bnep/Config.in
      source net/bluetooth/cmtp/Config.in
      source drivers/bluetooth/Config.in
   fi

   endmenu
fi
```

## net/ipv4/Config.in
```kconfig
#
# IP configuration
#
bool '  IP: multicasting' CONFIG_IP_MULTICAST
bool '  IP: advanced router' CONFIG_IP_ADVANCED_ROUTER
if [ "$CONFIG_IP_ADVANCED_ROUTER" = "y" ]; then
   bool '    IP: policy routing' CONFIG_IP_MULTIPLE_TABLES
   if [ "$CONFIG_IP_MULTIPLE_TABLES" = "y" ]; then
      if [ "$CONFIG_NETFILTER" = "y" ]; then
         bool '      IP: use netfilter MARK value as routing key' CONFIG_IP_ROUTE_FWMARK
      fi
      bool '      IP: fast network address translation' CONFIG_IP_ROUTE_NAT
   fi
   bool '    IP: equal cost multipath' CONFIG_IP_ROUTE_MULTIPATH
   bool '    IP: use TOS value as routing key' CONFIG_IP_ROUTE_TOS
   bool '    IP: verbose route monitoring' CONFIG_IP_ROUTE_VERBOSE
fi
bool '  IP: kernel level autoconfiguration' CONFIG_IP_PNP
if [ "$CONFIG_IP_PNP" = "y" ]; then
   bool '    IP: DHCP support' CONFIG_IP_PNP_DHCP
   bool '    IP: BOOTP support' CONFIG_IP_PNP_BOOTP
   bool '    IP: RARP support' CONFIG_IP_PNP_RARP
# not yet ready..
#   bool '    IP: ARP support' CONFIG_IP_PNP_ARP		
fi
tristate '  IP: tunneling' CONFIG_NET_IPIP
tristate '  IP: GRE tunnels over IP' CONFIG_NET_IPGRE
if [ "$CONFIG_IP_MULTICAST" = "y" ]; then
   if [ "$CONFIG_NET_IPGRE" != "n" ]; then
      bool '    IP: broadcast GRE over IP' CONFIG_NET_IPGRE_BROADCAST
   fi
   bool '  IP: multicast routing' CONFIG_IP_MROUTE
   if [ "$CONFIG_IP_MROUTE" = "y" ]; then
      bool '    IP: PIM-SM version 1 support' CONFIG_IP_PIMSM_V1
      bool '    IP: PIM-SM version 2 support' CONFIG_IP_PIMSM_V2
   fi
fi
if [ "$CONFIG_EXPERIMENTAL" = "y" ]; then
   bool '  IP: ARP daemon support (EXPERIMENTAL)' CONFIG_ARPD
fi
bool '  IP: TCP Explicit Congestion Notification support' CONFIG_INET_ECN
bool '  IP: TCP syncookie support (disabled per default)' CONFIG_SYN_COOKIES
if [ "$CONFIG_NETFILTER" != "n" ]; then
   source net/ipv4/netfilter/Config.in
fi
if [ "$CONFIG_NETFILTER" != "n" ]; then
   source net/ipv4/ipvs/Config.in
fi
```

## net/ipv6/Config.in
```kconfig
#
# IPv6 configuration
# 

#bool '    IPv6: flow policy support' CONFIG_RT6_POLICY
#bool '    IPv6: firewall support' CONFIG_IPV6_FIREWALL

if [ "$CONFIG_NETFILTER" != "n" ]; then
   source net/ipv6/netfilter/Config.in
fi
```

## net/irda/Config.in
```kconfig
#
# IrDA protocol configuration
#

if [ "$CONFIG_NET" != "n" ]; then

   mainmenu_option next_comment
   comment 'IrDA (infrared) support'
   dep_tristate 'IrDA subsystem support' CONFIG_IRDA $CONFIG_NET

   if [ "$CONFIG_IRDA" != "n" ]; then
      comment 'IrDA protocols'
      source net/irda/irlan/Config.in
      source net/irda/irnet/Config.in
      source net/irda/ircomm/Config.in
      bool '  Ultra (connectionless) protocol' CONFIG_IRDA_ULTRA
      comment 'IrDA options'
      bool '  Cache last LSAP' CONFIG_IRDA_CACHE_LAST_LSAP
      bool '  Fast RRs (low latency)' CONFIG_IRDA_FAST_RR
      bool '  Debug information' CONFIG_IRDA_DEBUG
   fi

   if [ "$CONFIG_IRDA" != "n" ]; then
      source drivers/net/irda/Config.in
   fi
   endmenu
fi
```

## net/sctp/Config.in
```kconfig
#
# SCTP configuration
#
mainmenu_option next_comment
comment '   SCTP Configuration (EXPERIMENTAL)'

tristate '  The SCTP Protocol (EXPERIMENTAL)' CONFIG_IP_SCTP

if [ "$CONFIG_IP_SCTP" = "y" -a "$CONFIG_IPV6" = "m" ]; then
	define_tristate CONFIG_IP_SCTP m
fi

if [ "$CONFIG_IP_SCTP" != "n" ]; then
  bool '    SCTP: Debug messages' CONFIG_SCTP_DBG_MSG
  bool '    SCTP: Debug object counts' CONFIG_SCTP_DBG_OBJCNT
  if [ "$CONFIG_CRYPTO_HMAC" = "n" ]; then
    choice '    SCTP: Cookie HMAC Algorithm' \
      "HMAC-NONE		CONFIG_SCTP_HMAC_NONE" HMAC-NONE
  else
    if [ "$CONFIG_CRYPTO_MD5" = "n" -a "$CONFIG_CRYPTO_SHA1" = "n" ]; then
      choice '    SCTP: Cookie HMAC Algorithm' \
        "HMAC-NONE		CONFIG_SCTP_HMAC_NONE" HMAC-NONE
    else
      if [ "$CONFIG_CRYPTO_MD5" != "n" -a "$CONFIG_CRYPTO_SHA1" != "n" ]; then
        choice '    SCTP: Cookie HMAC Algorithm' \
          "HMAC-NONE		CONFIG_SCTP_HMAC_NONE \
           HMAC-SHA1              CONFIG_SCTP_HMAC_SHA1 \
           HMAC-MD5		CONFIG_SCTP_HMAC_MD5"	HMAC-MD5
      else
        if [ "$CONFIG_CRYPTO_MD5" != "n" ]; then
          choice 'SCTP: Cookie HMAC Algorithm' \
          "HMAC-NONE		CONFIG_SCTP_HMAC_NONE \
           HMAC-MD5		CONFIG_SCTP_HMAC_MD5"	HMAC-MD5
        else
          choice 'SCTP: Cookie HMAC Algorithm' \
          "HMAC-NONE		CONFIG_SCTP_HMAC_NONE \
           HMAC-SHA1		CONFIG_SCTP_HMAC_SHA1"	HMAC-SHA1
        fi
      fi
    fi
  fi
fi
endmenu
```

## sys/ofed/drivers/infiniband/hw/qib/Kconfig
```kconfig
config INFINIBAND_QIB
	tristate "QLogic IB Driver"
	depends on 64BIT && INFINIBAND
	---help---
	This is a driver for QLogic PCIe QLE IB host channel adapters,
	including InfiniBand verbs support.  This driver allows these
	devices to be used with both kernel upper level protocols such
	as IP-over-InfiniBand as well as with userspace applications
	(in conjunction with InfiniBand userspace access).
```

## sys/ofed/drivers/infiniband/ulp/qlgc_vnic/Kconfig
```kconfig
config INFINIBAND_QLGC_VNIC
	tristate "QLogic VNIC - Support for QLogic Ethernet Virtual I/O Controller"
	depends on INFINIBAND && NETDEVICES && INET
	---help---
	  Support for the QLogic Ethernet Virtual I/O Controller
	  (EVIC). In conjunction with the EVIC, this provides virtual
	  ethernet interfaces and transports ethernet packets over
	  InfiniBand so that you can communicate with Ethernet networks
	  using your IB device.

config INFINIBAND_QLGC_VNIC_STATS
	bool "QLogic VNIC Statistics"
	depends on INFINIBAND_QLGC_VNIC
	default n
	---help---
	  This option compiles statistics collecting code into the
	  data path of the QLogic VNIC driver to help in profiling and fine
	  tuning. This adds some overhead in the interest of gathering
	  data.
```

## sys/ofed/drivers/infiniband/ulp/sdp/Kconfig
```kconfig
config INFINIBAND_SDP
	tristate "Sockets Direct Protocol"
	depends on INFINIBAND && INFINIBAND_IPOIB
	---help---
	  Support for Sockets Direct Protocol (SDP).  This provides
          sockets semantics over InfiniBand via address family
          AF_INET_SDP (address family 27).  You can also LD_PRELOAD the
          libsdp library from <http://openib.org> to have standard
          sockets applications use SDP.

config INFINIBAND_SDP_DEBUG
	bool "Sockets Direct Protocol debugging"
	depends on INFINIBAND_SDP
	---help---
	  This option causes debugging code to be compiled into the
	  SDP driver.  The output can be turned on via the debug_level
	  module parameter  (which can also be set through sysfs after the
	  driver is loaded).

config INFINIBAND_SDP_DEBUG_DATA
        bool "Sockets Direct Protocol data path debugging"
        depends on INFINIBAND_SDP_DEBUG
        ---help---
          This option compiles debugging code into the the data path
          of the SDP driver.  The output can be turned on via the
          data_debug_level module parameter; however, even with output
          turned off, this debugging code will have some performance
          impact.
```

## sys/ofed/drivers/infiniband/util/Kconfig
```kconfig
config INFINIBAND_MADEYE
	tristate "MAD debug viewer for InfiniBand"
	depends on INFINIBAND
	---help---
	  Prints sent and received MADs on QP 0/1 for debugging.
```
