OUTPUT_FORMAT("srec")
SECTIONS
{


.text 0 : { *("9") *("10") *("11") *("12") *("13") *("14") *("15")
		*("7") *("8") *("0") *("1") *("2") *("3") *("4") }
.bss   : {  *("5") *("6") }

.PAFI    =0x00000050 ;
.PCHIO   =0x000000D0 ;
.PCLO    =0x00000054 ;
.PCVBSV  =0x0000000E ;
.PCVTSU  =0x00000012 ;
.PCVTSV  =0x00000016 ;
.PCVTSVL =0x0000001A ;
.PCVTUS  =0x0000001E ;
.PDIS    =0x00000022 ;
.PDISL   =0x00000026 ;
.PDVJ    =0x0000002A ;
.PEIO    =0x000000CC ;
.PEOF    =0x00000058 ;
.PEOL    =0x0000005C ;
.PEQUS   =0x0000002E ;
.PEQUV   =0x00000032 ;
.PEQUVL  =0x00000036 ;
.PEQUW   =0x000000DE ;
.PGCM    =0x00000064 ;
.PGEQS   =0x0000003A ;
.PGEQV   =0x0000003E ;
.PGEQVL  =0x00000042 ;
.PGET    =0x00000060 ;
.PGRTS   =0x00000046 ;
.PGRTV   =0x0000004A ;
.PGRTVL  =0x0000004E ;
.PIACT   =0x0000006C ;
.PIFD    =0x00000068 ;
.PINDS   =0x00000052 ;
.PINDV   =0x00000056 ;
.PINDVL  =0x0000005A ;
.PINDW   =0x000000D6 ;
.PLDCS   =0x0000005E ;
.PLDCV   =0x00000062 ;
.PLEQS   =0x00000066 ;
.PLEQV   =0x0000006A ;
.PLEQVL  =0x0000006E ;
.PLESS   =0x00000072 ;
.PLESV   =0x00000076 ;
.PLESVL  =0x0000007A ;
.PLODS   =0x0000007E ;
.PLODV   =0x00000082 ;
.PLODVL  =0x00000086 ;
.PMODJ   =0x0000008A ;
.PMOV    =0x000000E2 ;
.PMPJ    =0x0000008E ;
.PNEQS   =0x00000092 ;
.PNEQV   =0x00000096 ;
.PNEQVL  =0x0000009A ;
.PNEQW   =0x000000DA ;
.PPAGE   =0x000000D4 ;
.PPEE    =0x00000070 ;
.PPUT    =0x00000074 ;
.PRDB    =0x00000078 ;
.PRDC    =0x0000007C ;
.PRDH    =0x00000080 ;
.PRDI    =0x00000084 ;
.PRDJ    =0x00000088 ;
.PRDRS   =0x000000C8 ;
.PRDS    =0x0000008C ;
.PRDV    =0x00000090 ;
.PRLN    =0x00000094 ;
.PRRAN   =0x00000098 ;
.PRST    =0x0000009C ;
.PRWT    =0x000000A0 ;
.PSCON   =0x0000009E ;
.PSCOP   =0x000000A2 ;
.PSDEL   =0x000000A6 ;
.PSINS   =0x000000AA ;
.PSLEN   =0x000000AE ;
.PSPOS   =0x000000B2 ;
.PSTCV   =0x000000B6 ;
.PSTCVL  =0x000000BA ;
.PSTOS   =0x000000BE ;
.PSTOV   =0x000000C2 ;
.PSTOVL  =0x000000C6 ;
.PSTRS   =0x000000CA ;
.PSTRV   =0x000000CE ;
.PSTRVL  =0x000000D2 ;
.PWLN    =0x000000A4 ;
.PWRAN   =0x000000A8 ;
.PWRB    =0x000000AC ;
.PWRC    =0x000000B0 ;
.PWRH    =0x000000B4 ;
.PWRI    =0x000000B8 ;
.PWRJ    =0x000000BC ;
.PWRS    =0x000000C0 ;
.PWRV    =0x000000C4 ;

/*
.PAFI=0x   = 0x00;
.PCHIO   =0x 0x000000;
.PCLO    =0x 64 ;
.PC;
.PCVTSU  =0x 0x000000;
.PCVTSV  =0x 0x000000;
.PCVTSVL =0x 0x000000;
.PCVTUS  =0x 158 ;
.P;
.PDISL   =0x 0x000000;
.PDVJ    =0x 0x000000;
.PEIO    =0x 0x000000;
.PEOF    =0x 0x000000;
.PEOL    =0x 0x000000;
.PEQUS   =0x 0x000000;
.PEQUV   =0x 0x000000;
.PEQUVL  =0x 0x000000;
.PEQUW   =0x 0x000000;
.PGCM    =0x 0x000000;
.PGEQS   =0x 0x000000;
.PGEQV   =0x 0x000000;
.PGEQVL  =0x 0x000000;
.PGET    =0x 0x000000;
.PGRTS   =0x 0x000000;
.PGRTV   =0x 0x000000;
.PGRTVL  =0x 0x000000;
.PIACT   =0x 0x000000;
.PIFD    =0x 126 ;
.P;
.PINDV   =0x 0x000000;
.PINDVL  =0x 0x000000;
.PINDW   =0x 0x000000;
.PLDCS   =0x 0x000000;
.PLDCV   =0x 0x000000;
.PLEQS   =0x 0x000000;
.PLEQV   =0x 0x000000;
.PLEQVL  =0x 0x000000;
.PLESS   =0x 0x000000;
.PLESV   =0x 0x000000;
.PLESVL  =0x 0x000000;
.PLODS   =0x 0x000000;
.PLODV   =0x 0x000000;
.PLODVL  =0x 0x000000;
.PMODJ   =0x 0x000000;
.PMOV    =0x 0x000000;
.PMPJ    =0x 0x000000;
.PNEQS   =0x 0x000000;
.PNEQV   =0x 0x000000;
.PNEQVL  =0x 0x000000;
.PNEQW   =0x 0x000000;
.PPAGE   =0x 0x000000;
.PPEE    =0x 0x000000;
.PPUT    =0x 0x000000;
.PRDB    =0x 0x000000;
.PRDC    =0x 0x000000;
.PRDH    =0x 0x000000;
.PRDI    =0x 0x000000;
.PRDJ    =0x 0x000000;
.PRDRS   =0x 0x000000;
.PRDS    =0x 0x000000;
.PRDV    =0x 0x000000;
.PRLN    =0x 0x000000;
.PRRAN   =0x 0x000000;
.PRST    =0x 0x000000;
.PRWT    =0x 0x000000;
.PSCON   =0x 0x000000;
.PSCOP   =0x 0x000000;
.PSDEL   =0x 0x000000;
.PSINS   =0x 0x000000;
.PSLEN   =0x 0x000000;
.PSPOS   =0x 0x000000;
.PSTCV   =0x 0x000000;
.PSTCVL  =0x 0x000000;
.PSTOS   =0x 0x000000;
.PSTOV   =0x 0x000000;
.PSTOVL  =0x 0x000000;
.PSTRS   =0x 0x000000;
.PSTRV   =0x 0x000000;
.PSTRVL  =0x 0x000000;
.PWLN    =0x 0x000000;
.PWRAN   =0x 0x000000;
.PWRB    =0x 0x000000;
.PWRC    =0x 0x000000;
.PWRH    =0x 0x000000;
.PWRI    =0x 0x000000;
.PWRJ    =0x 0x000000;
.PWRS    =0x 0x000000;
.PWRV    =0x 0x000000;

*/
/*
.P=0x      = 0;
.PCHIO   =0x 0xfeedfa;
.PCLO    =0x 0xfeedfa;
.PCVBSV  =0x 0xfeedfa;
.PCVTSU  =0x 0xfeedfa;
.PCVTSV  =0x 0xfeedfa;
.PCVTSVL =0x 0xfeedfa;
.PCVTUS  =0x 0xfeedfa;
.PDIS    =0x 0xfeedfa;
.PDISL   =0x 0xfeedfa;
.PDVJ    =0x 0xfeedfa;
.PEIO    =0x 0xfeedfa;
.PEOF    =0x 0xfeedfa;
.PEOL    =0x 0xfeedfa;
.PEQUS   =0x 0xfeedfa;
.PEQUV   =0x 0xfeedfa;
.PEQUVL  =0x 0xfeedfa;
.PEQUW   =0x 0xfeedfa;
.PGCM    =0x 0xfeedfa;
.PGEQS   =0x 0xfeedfa;
.PGEQV   =0x 0xfeedfa;
.PGEQVL  =0x 0xfeedfa;
.PGET    =0x 0xfeedfa;
.PGRTS   =0x 0xfeedfa;
.PGRTV   =0x 0xfeedfa;
.PGRTVL  =0x 0xfeedfa;
.PIACT   =0x 0xfeedfa;
.PIFD    =0x 0xfeedfa;
.PINDS   =0x 0xfeedfa;
.PINDV   =0x 0xfeedfa;
.PINDVL  =0x 0xfeedfa;
.PINDW   =0x 0xfeedfa;
.PLDCS   =0x 0xfeedfa;
.PLDCV   =0x 0xfeedfa;
.PLEQS   =0x 0xfeedfa;
.PLEQV   =0x 0xfeedfa;
.PLEQVL  =0x 0xfeedfa;
.PLESS   =0x 0xfeedfa;
.PLESV   =0x 0xfeedfa;
.PLESVL  =0x 0xfeedfa;
.PLODS   =0x 0xfeedfa;
.PLODV   =0x 0xfeedfa;
.PLODVL  =0x 0xfeedfa;
.PMODJ   =0x 0xfeedfa;
.PMOV    =0x 0xfeedfa;
.PMPJ    =0x 0xfeedfa;
.PNEQS   =0x 0xfeedfa;
.PNEQV   =0x 0xfeedfa;
.PNEQVL    = 0xfeedface;
.PNEQW     = 0xfeedface;
.PPAGE     = 0xfeedface;
.PPEE      = 0xfeedface;
.PPUT      = 0xfeedface;
.PRDB      = 0xfeedface;
.PRDC      = 0xfeedface;
.PRDH      = 0xfeedface;
.PRDI      = 0xfeedface;
.PRDJ      = 0xfeedface;
.PRDRS     = 0xfeedface;
.PRDS      = 0xfeedface;
.PRDV      = 0xfeedface;
.PRLN      = 0xfeedface;
.PRRAN     = 0xfeedface;
.PRST      = 0xfeedface;
.PRWT      = 0xfeedface;
.PSCON     = 0xfeedface;
.PSCOP     = 0xfeedface;
.PSDEL     = 0xfeedface;
.PSINS     = 0xfeedface;
.PSLEN     = 0xfeedface;
.PSPOS     = 0xfeedface;
.PSTCV     = 0xfeedface;
.PSTCVL    = 0xfeedface;
.PSTOS     = 0xfeedface;
.PSTOV     = 0xfeedface;
.PSTOVL    = 0xfeedface;
.PSTRS     = 0xfeedface;
.PSTRV     = 0xfeedface;
.PSTRVL    = 0xfeedface;
.PWLN      = 0xfeedface;
.PWRAN     = 0xfeedface;
.PWRB      = 0xfeedface;
.PWRC      = 0xfeedface;
.PWRH      = 0xfeedface;
.PWRI      = 0xfeedface;
.PWRJ      = 0xfeedface;
.PWRS      = 0xfeedface;
.PWRV      = 0xfeedface;
*/

}
